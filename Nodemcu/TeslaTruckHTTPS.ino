#include <ESP8266WiFi.h>
#include <WiFiClient.h>
#include <ESP8266WebServerSecure.h>
#include <ESP8266mDNS.h>
#include "pitches.h"
#include <Servo.h>

#ifndef STASSID
#define STASSID "xx"
#define STAPSK  "xx"
#endif

//****************************pins**************************
#define motorLeftForward 16   //D0
#define motorLeftBackward 5   //D1
#define motorRightForward 4   //D2
#define motoRightBackward 0   //D3
#define hornPin 14            //D5
#define rightIndicatorPin 12  //D6
#define leftIndicatorPin 13   //D7
#define lightPin 15           //D8

const char html_index[] = {"<!DOCTYPE html>\n<html>\n<link rel=\"stylesheet\" href=\"https://cdn.materialdesignicons.com/2.5.94/css/materialdesignicons.min.css\">\n<script src=\"https://kit.fontawesome.com/fef9c30a7a.js\" crossorigin=\"anonymous\"></script>\n<meta name=\"mobile-web-app-capable\" content=\"yes\">\n<meta name=\"viewport\" content=\"width=device-width, user-scalable=no\">\n<head>\n\t<link rel=\"manifest\" href=\"/manifest.json\">\n\t<link rel=\"stylesheet\" href=\"styles.css\" type=\"text.css\">\n\t<meta name=\"theme-color\" content=\"#4285f4\" />\n\t<script src=\"https://code.jquery.com/jquery-3.1.0.min.js\"> </script>\n\t<title>Tesla Truck Control</title>\n</head>\n\t<body>\n\t\t<form method=\"get\">\n\t\t\t<div class=\"grid-container\">\n\t\t\t\t<div class=\"Left-Indicator\">\n\t\t\t\t\t<button type=\"button\" class=\"button\" id=\"left-indicator-button\" onclick= window.location.href='/leftindicator'>\n\t\t\t\t\t\t\t<i class=\"far fa-caret-square-left\" id=\"left-indicator-icon\"></i>\n\t\t\t\t\t</button>\n\t\t\t\t</div>\n\n\t\t\t\t<div class=\"Lights\">\n\t\t\t\t\t<button type=\"button\" class=\"button\" id=\"lights-button\" onclick= window.location.href='/lights'>\n\t\t\t\t\t\t<i class=\"fas fa-lightbulb\" id=\"lights-icon\"></i>\n\t\t\t\t\t</button>\n\t\t\t\t</div>\n\n\t\t\t\t<div class=\"Emergency\">\n\t\t\t\t\t<button type=\"button\" class=\"button\" id=\"emergency-buttom\" onclick= window.location.href='/emergency'>\n\t\t\t\t\t\t<i class=\"mdi mdi-triangle-outline\" id=\"emergency-icon\"></i>\n\t\t\t\t\t</button>\n\t\t\t\t</div>\n\n\t\t\t\t<div class=\"Right-Indicator\">\n\t\t\t\t\t<button type=\"button\" class=\"button\" id=\"right-indicator-button\" onclick= window.location.href='/rightindicator'>\n\t\t\t\t\t\t<i class=\"far fa-caret-square-right\" id=\"right-indicator-icon\"></i>\n\t\t\t\t\t</button>\n\t\t\t\t</div>\n\n\t\t\t\t<div class=\"Go\">\n\t\t\t\t\t<button type=\"button\" class=\"button\" id=\"go-button\"onclick= window.location.href='/go'>\n\t\t\t\t\t\t<i class=\"fas fa-arrow-alt-circle-up\" id=\"go-icon\"></i>\n\t\t\t\t\t</button>\n\t\t\t\t</div>\n\n\t\t\t\t<div class=\"Horn\">\n\t\t\t\t\t<button type=\"button\" class=\"button\" id=\"horn-button\" onclick= window.location.href='/horn'>\n\t\t\t\t\t\t<i class=\"fas fa-bullhorn\" id=\"horn-icon\"></i>\n\t\t\t\t\t</button>\n\t\t\t\t</div>\n\n\t\t\t\t<div class=\"Left\">\n\t\t\t\t\t<button type=\"button\" class=\"button\" id=\"left-button\" onclick= window.location.href='/left'> \n\t\t\t\t\t\t<i class=\"fas fa-long-arrow-alt-left\" id=\"left-icon\"></i>\n\t\t\t\t\t</button>\n\t\t\t\t</div>\n\n\t\t\t\t<div class=\"Right\">\n\t\t\t\t\t<button type=\"button\" class=\"button\" id=\"right-button\" onclick= window.location.href='/right'>\n\t\t\t\t\t\t<i class=\"fas fa-long-arrow-alt-right\" id=\"right-icon\"></i>\n\t\t\t\t\t</button>\n\t\t\t\t</div>\n\n\t\t\t\t<div class=\"Stop\">\n\t\t\t\t\t<button type=\"button\" class=\"button\" id=\"stop-button\" onclick= window.location.href='/stop'>\n\t\t\t\t\t\t<i class=\"fas fa-minus-circle\" id=\"stop-icon\"></i>\n\t\t\t\t\t</button>\n\t\t\t\t</div>\n\t\t\t</div>\n\t\t</form>\n\t\t<script>\n\t\tif ('serviceWorker' in navigator) {\n\t\t  window.addEventListener('load', function() {\n\t\t    navigator.serviceWorker.register('service-worker.js')\n\t\t      .then(reg => {\n\t\t        console.log('Service worker registered!', reg);\n\t\t      })\n\t\t      .catch(err => {\n\t\t        console.log('Service worker registration failed: BULLSHIT', err);\n\t\t      });\n\t\t  });\n\t\t}\n\t\t</script>\n\t</body>\n</html>"};
const char offline_html[] = {"<!DOCTYPE html>\n<html>\n<head>\n\t<title>404</title>\n</head>\n<body>\n\t<h1>Not Found fucker</h1>\n</body>\n</html>"};
const char styles_css[] PROGMEM = {"html, body \n{\n\tmargin:0%;\n\theight: 100%;\n\toverflow: hidden;\n\tbackground-color: #000000;\n}\n\n.grid-container\n{\n\tbackground-color: #000000;\n}\n\n.button:active\n{\n\tbackground-color: #241e1e;\n}\n\n.button\n{\n\tbackground-color: #3e3636;\n\tborder-color: #000000;\n\toutline: 0;\n}\n\n#emergency-icon\n{\n\tfont-weight: bold;\n\tcolor: #b3000c;\n}\n\n#lights-icon\n{\n\tcolor: #aeb025;\n}\n\n#left-indicator-icon,#right-indicator-icon\n{\n\tcolor: #b07425;\n}\n\n#go-icon\n{\n\tcolor: #00b32c;\n}\n\n#horn-icon\n{\n\tcolor: #d8d8d8;\n}\n\n#stop-icon\n{\n\tcolor: #b3000c;\n}\n\n#left-icon,#right-icon\n{\n\tcolor: #d8d8d8;\n}\n\n@media only screen and (max-width: 361px)\n{\n\tbody\n\t{\n\t\tpadding-top: 5rem;\n\t}\n\t.grid-container \n\t{\n\t\tdisplay: grid;\n\t\tgrid-template-columns: 1fr 1fr 1fr 1fr 1fr 1fr;\n\t\tgrid-template-rows: 1fr 1fr 1fr 1fr 1fr 1fr 1fr 1fr 1fr;\n\t\tgrid-column-gap: 1%;\n\t\tgrid-row-gap: 1%;\n\t\theight: 100%;\n\t\tpadding: 0;\n\t\tmargin-bottom: 1%;\n\t}\n\n\t.button \n\t{\n\twidth: 100%;\n\theight: 100%;\n\tborder-radius: 4rem;\n\t}\n\n\t.Left-Indicator \n\t{\n\t\tgrid-column: 1/3;\n\t\tgrid-row: 1/3;\n\t}\n\n\t.Lights \n\t{\n\t\tgrid-column: 3/5;\n\t\tgrid-row: 1;\n\t}\n\n\t.Emergency \n\t{\n\t\tgrid-column: 3/5;\n\t\tgrid-row: 2;\n\t}\n\n\t.Right-Indicator \n\t{\n\t\tgrid-column: 5/7;\n\t\tgrid-row: 1/3;\n\t}\n\n\t.Go \n\t{\n\t\tgrid-column: 4/7;\n\t\tgrid-row: 7/10;\n\t}\n\n\t.Horn\n\t{\n\t\tgrid-column:1/7;\n\t\tgrid-row: 3;\n\t}\n\n\t.Left \n\t{\n\t\tgrid-column: 1/4;\n\t\tgrid-row: 4/7;\n\t}\n\n\t.Right \n\t{\n\t\tgrid-column: 4/7;\n\t\tgrid-row: 4/7;\n\t}\n\n\t.Stop \n\t{\n\t\tgrid-column: 1/4;\n\t\tgrid-row: 7/10;\n\t}\n\n\t#emergency-icon\n\t{\n\t\tfont-size: 2rem;\t\t\t\t\n\t}\n\n\t#lights-icon\n\t{\n\t\tfont-size: 2rem;\n\t}\n\n\t#left-indicator-icon,#right-indicator-icon{\n\t\tfont-size: 4rem;\n\t}\n\n\t#go-icon{\n\t\tfont-size: 8rem;\n\t}\n\n\t#horn-icon{\n\t\tfont-size: 2rem;\n\t}\n\n\t#stop-icon{\n\t\tfont-size: 8rem;\t\t\t\t\n\t}\n\n\t#left-icon,#right-icon{\n\t\tfont-size: 8rem;\t\t\t\t\n\t}\n}\n\n@media only screen and (min-width: 362px)\n{\n\tbody\n\t{\n\t\tpadding-top: 1rem;\n\t}\n\t.grid-container \n\t{\n\t\tdisplay: grid;\n\t\tgrid-template-columns: 1fr 1fr 1fr 1fr 1fr 1fr 1fr 1fr 1fr;\n\t\tgrid-template-rows: 1fr 1fr 1fr 1fr 1fr 1fr;\n\t\tgrid-column-gap: 1%;\n\t\tgrid-row-gap: 1%;\n\t\theight: 100%;\n\t\tpadding: 0;\n\t\tmargin-bottom: 1%;\n\t\tbackground-color: #000000;\n\t}\n\t.Left-Indicator {\n\t\tgrid-column: 1/3;\n\t\tgrid-row: 1/3;\n\t}\n\n\t.Lights {\n\t\tgrid-column: 3/5;\n\t\tgrid-row: 1;\n\t}\n\n\t.Emergency {\n\t\tgrid-column: 3/5;\n\t\tgrid-row: 2;\n\t}\n\n\t.Right-Indicator {\n\t\tgrid-column: 5/7;\n\t\tgrid-row: 1/3;\n\t}\n\n\t.Go {\n\t\tgrid-column: 7/10;\n\t\tgrid-row: 1/4;\n\t}\n\n\t.Horn{\n\t\tgrid-column:1/7;\n\t\tgrid-row: 3;\n\t}\n\n\t.Left {\n\t\tgrid-column: 1/4;\n\t\tgrid-row: 4/7;\n\t}\n\n\t.Right {\n\t\tgrid-column: 4/7;\n\t\tgrid-row: 4/7;\n\t}\n\n\t.Stop {\n\t\tgrid-column: 7/10;\n\t\tgrid-row: 4/7;\n\t}\n\n\t#emergency-icon{\n\t\tfont-size: 1rem;\n\t}\n\n\t#lights-icon{\n\t\tfont-size: rem;\n\t}\n\n\t#left-indicator-icon,#right-indicator-icon{\n\t\tfont-size: 4rem;\n\t}\n\n\t#go-icon{\n\t\tfont-size: 9rem;\n\t}\n\n\t#horn-icon{\n\t\tfont-size: 1rem;\n\t}\n\n\t#stop-icon{\n\t\tfont-size: 9rem;\n\t}\n\n\t#left-icon,#right-icon{\n\t\tfont-size: 9rem;\n\t}\n\n\t.button \n\t{\n\twidth: 100%;\n\theight: 100%;\n\tborder-radius: 5rem;\n\t}\n\n}"};
const char manifest_js[] = {"{\n  \"short_name\": \"CyberTruck\",\n  \"name\": \"Tesla Cyber Truck\",\n  \"icons\": [\n    {\n      \"src\": \"/images/tesla_192.png\",\n      \"type\": \"image/png\",\n      \"sizes\": \"192x192\"\n    },\n    {\n      \"src\": \"/images/tesla_512.png\",\n      \"type\": \"image/png\",\n      \"sizes\": \"512x512\"\n    }\n  ],\n  \"start_url\": \"/\",\n  \"display\": \"fullscreen\",\n  \"background_color\": \"#3367D6\"\n}"};
const char serviceWorker_js[] PROGMEM = {"const cacheName = 'cache-v1';\nconst precacheResources = [\n  '/',\n  'index.html',\n  'offine/offline.html'\n];\n\nself.addEventListener('install', event => {\n  console.log('Service worker install event!');\n  event.waitUntil(\n    caches.open(cacheName)\n      .then(cache => {\n        return cache.addAll(precacheResources);\n      })\n  );\n});\n\nself.addEventListener('activate', event => {\n  console.log('Service worker activate event!');\n});\n\nself.addEventListener('fetch', event => {\n  console.log('Fetch intercepted for:', event.request.url);\n  event.respondWith(caches.match(event.request)\n    .then(cachedResponse => {\n        if (cachedResponse) {\n          return cachedResponse;\n        }\n        return fetch(event.request);\n      })\n    );\n});"};
const char tesla_192_png[] PROGMEM= {0x89, 0x50, 0x4E, 0x47, 0x0D, 0x0A, 0x1A, 0x0A, 0x00, 0x00, 0x00, 0x0D, 0x49,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 0x82,};
const char tesla_512_png[] PROGMEM= {0x89, 0x50, 0x4E, 0x47, 0x0D, 0x0A, 0x1A, 0x0A, 0x00, 0x00, 0x00, 0x0D, 0x49,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 0x82,};

const char* ssid = STASSID;
const char* password = STAPSK;

ESP8266WebServerSecure server(443);

// The certificate is stored in PMEM
static const uint8_t x509[] PROGMEM = 
{
  #include "x509.h"
};

// And so is the key.  These could also be in DRAM
static const uint8_t rsakey[] PROGMEM = 
{
  #include "key.h"
};

//control modes
int car_mode = 0; //this will control the movement of the car
int steering_mode = 0; //this will control the direction of the car
int light_mode = 0; //this will control the lighting of the car
int indicator_mode = 0; //this will control the indicators
int horn_mode = 0; //this will control the horn

//timer set up
unsigned long previousMillis = 0;
unsigned long previousMilliss = 0;
unsigned long startTime = 0;

//Lights
int lightState = LOW;
int leftIndicatorState = LOW;
int rightIndicatorState = LOW;
int bothIndicatorState = LOW;

//Horn Melody
int melody[] = {NOTE_C4, NOTE_G3, NOTE_G3, NOTE_A3, NOTE_G3, 0, NOTE_B3, NOTE_C4};
int noteDurations[] = {4, 8, 8, 4, 4, 4, 4, 4};
unsigned long previousNoteMillis = 0;
int noteCounter = 0;
int numberOfNotes = sizeof(melody)/sizeof(int);
boolean outputTone = false;

void setup(void) 
{
  //setting up the horn
  pinMode(hornPin, OUTPUT);
  
//setting up light pins and turning off
  pinMode(leftIndicatorPin,OUTPUT);
  pinMode(rightIndicatorPin,OUTPUT);
  pinMode(lightPin,OUTPUT);
  digitalWrite(leftIndicatorPin,LOW);
  digitalWrite(rightIndicatorPin,LOW);
  digitalWrite(lightPin,LOW);

//setting up motor pins and turning off
  pinMode(motorLeftForward,OUTPUT);
  pinMode(motorLeftBackward,OUTPUT);
  pinMode(motorRightForward,OUTPUT);
  pinMode(motoRightBackward,OUTPUT);
  digitalWrite(motorLeftForward,LOW);
  digitalWrite(motorLeftBackward,LOW);
  digitalWrite(motorRightForward,LOW);
  digitalWrite(motoRightBackward,LOW);

  Serial.begin(115200);
  WiFi.begin(ssid, password);
  Serial.println("");

  // Wait for connection
  while (WiFi.status() != WL_CONNECTED) {
    delay(500);
    Serial.print(".");
  }
  Serial.println("");
  Serial.print("Connected to ");
  Serial.println(ssid);
  Serial.print("IP address: ");
  Serial.println(WiFi.localIP());

  if (MDNS.begin("esp8266")) {
    Serial.println("MDNS responder started");
  }

  
  server.setServerKeyAndCert_P(rsakey, sizeof(rsakey), x509, sizeof(x509));

  server.on("/", handleRoot);
  server.on("/index.html",handleIndex);
  server.on("/styles.css",handleCSS);
  server.on("/service-worker.js",handleServiceWorker);
  server.on("/offline/offline.html",handleOffline);
  server.on("/lights",HTTP_GET, handleLights);
  server.on("/go",HTTP_GET,handleGo);
  server.on("/stop",HTTP_GET,handleStop);
  server.on("/leftindicator",HTTP_GET,handleLeftIndicator);
  server.on("/rightindicator",HTTP_GET,handleRightIndicator);
  server.on("/emergency",HTTP_GET,handleEmergency);
  server.on("/horn",HTTP_GET,handleHorn);
  server.on("/left",HTTP_GET,handleLeft);
  server.on("/right",HTTP_GET,handleRight);
  server.on("/manifest.json",handleManifest);
  server.on("/images/tesla_192.png",handleTesla192);
  server.on("/images/tesla_512.png",handleTesla512);
  server.on("/inline", []() {
    server.send(200, "text/plain", "this works as well");
  });

  server.onNotFound(handleNotFound);

  server.begin();
  Serial.println("HTTPS server started");
  
  car_mode = 0; //Set car to stationary
  steering_mode = 0; //Set car to straight
  light_mode = 0; //turn off lights
  indicator_mode = 0; //turn of indicators
  horn_mode = 0;
  
}//end set up

void loop(void) 
{
  server.handleClient();
  MDNS.update();
  car_control();
  indicator_control();
  steering_control();
  light_control();
  horn_control();
}

void car_control()
{
  switch (car_mode)
  {
    case 0://stop the car
      {
        digitalWrite(motorLeftForward,LOW);
        digitalWrite(motorLeftBackward,LOW);
        digitalWrite(motorRightForward,LOW);
        digitalWrite(motoRightBackward,LOW);
      }
    break;
      
    case 1://forward
      {
        digitalWrite(motorLeftForward,HIGH);
        digitalWrite(motorLeftBackward,LOW);
        digitalWrite(motorRightForward,HIGH);
        digitalWrite(motoRightBackward,LOW);
      }
    break;
      
    case 2://backward
      {
        digitalWrite(motorLeftForward,LOW);
        digitalWrite(motorLeftBackward,HIGH);
        digitalWrite(motorRightForward,LOW);
        digitalWrite(motoRightBackward,HIGH);
      }
    break;
  }
}

void light_control()
{
  switch(light_mode)
  {
    case 0://lights off
    {
      digitalWrite(lightPin,LOW);
    } //end case 0
    break;
    
    case 1://lights on
    {
      digitalWrite(lightPin,HIGH);
    }//end case 1
    break;
    
    case 2://flash the lights
    {
      //nothing needed here but it stops working when deleted
    }//end case 2
    break;
  }
}//end light_control

void indicator_control()
{
  static boolean entryStateLeft = false;
  static boolean entryStateRight = false;
  
  switch (indicator_mode) 
  {
    case 0://off
    {
     digitalWrite(leftIndicatorPin,LOW);
     digitalWrite(rightIndicatorPin,LOW);
     entryStateLeft = false;
     entryStateRight = false;
    }//end case 0
    break;
    
    case 1://left indicator blink
    {
      entryStateRight = false;  
      digitalWrite(rightIndicatorPin,LOW);
      unsigned long currentMillis = millis();
      if(entryStateLeft == false)
      {
        startTime = currentMillis;
        entryStateLeft = true;
      }
      
      if(currentMillis-startTime <= 5000 && entryStateLeft == true)
      {
        if (currentMillis - previousMillis >= 500) 
        {
          previousMillis = currentMillis;
          if (leftIndicatorState == LOW) 
          {
            leftIndicatorState = HIGH;
            Serial.println("L1");
          } 
          else 
          {
            leftIndicatorState = LOW;
            Serial.println("L0");
          }    
          digitalWrite(leftIndicatorPin, leftIndicatorState);
        }
      }
      
      if (currentMillis - startTime >= 5000)
      {
        indicator_mode = 0;
        entryStateLeft = false;
        Serial.println("L off");
      }
    }//end case 1
    break;
    
    case 2://right indicator blink
    {
      entryStateLeft = false;
      digitalWrite(leftIndicatorPin,LOW);
      unsigned long currentMillis = millis();
      if(entryStateRight == false)
      {
        startTime = currentMillis;
        entryStateRight = true;
      }
      
      if(currentMillis-startTime <= 5000 && entryStateRight == true)
      {
        if (currentMillis - previousMillis >= 500) 
        {
          previousMillis = currentMillis;
          if (rightIndicatorState == LOW) 
          {
            rightIndicatorState = HIGH;
            Serial.println("R1");
          } 
          else 
          {
            rightIndicatorState = LOW;
            Serial.println("R0");
          }    
          digitalWrite(rightIndicatorPin, rightIndicatorState);
        }
      }

      if(currentMillis - startTime >= 5000)
      {
        indicator_mode = 0;
        entryStateRight = false;
        Serial.println("R off");
      }
         
    }//end case 2  
    break;
    
    case 3: //flash both indicators
    {
      unsigned long currentMillis = millis();
      if (currentMillis - previousMillis >= 500) 
      {
        previousMillis = currentMillis;
        if (leftIndicatorState == LOW) 
        {
          leftIndicatorState = HIGH;
        } 
        else 
        {
          leftIndicatorState = LOW;
        }    
        digitalWrite(rightIndicatorPin, leftIndicatorState);
        digitalWrite(leftIndicatorPin, leftIndicatorState);
        digitalWrite(lightPin, leftIndicatorState);
      }     
    }//end case 3  
    break;
  }
}

void steering_control()
{
  switch (steering_mode)
  {
    case 0: //straight
    {
      
    }//end case 0
    break;
    case 1: //left
    {
      
    }//end case 1
    break;
    case 2: //right
    {
      
    }// end case 2
    break;
  }
}

void horn_control()
{
  switch (horn_mode)
  {
    case 0://horn off
    {
      noteCounter=0;
    }
    break;

    case 1://horn on
    {
      unsigned long currentNoteMillis = millis();
      unsigned long noteDuration = 500 / noteDurations[noteCounter];
      unsigned long pauseBetweenNotes = noteDuration * 1;
    
    
      if (noteCounter < numberOfNotes) 
      {
        if (outputTone && ((currentNoteMillis - previousNoteMillis) >= noteDuration)) 
        {
            previousNoteMillis = currentNoteMillis;
            noTone(hornPin);
            outputTone = false;
            noteCounter++;
        }
        else 
        {
            if ((currentNoteMillis - previousNoteMillis) >= pauseBetweenNotes) 
            {
              previousNoteMillis = currentNoteMillis;      
              if (melody[noteCounter] == 0) 
              {
                noTone(hornPin);
              } 
              else 
              {
                tone(hornPin, melody[noteCounter]);
              }
              outputTone = true;
          }
        }
      }
      if(noteCounter==numberOfNotes)
      {
        noteCounter=0;
        horn_mode=0;     
      }
    }
    break;
  }
}

void handleGo()
{
  if(car_mode == 0) //if car is stationary - you may go forward
  {
    car_mode = 1;
    Serial.println("Forward");
  }
  else if(car_mode == 1 || car_mode == 2) //if car is going backwards - stop
  {
    car_mode = 0;
    Serial.println("stop");
  }
  server.send(200, "text/html", html_index);
}

void handleStop()
{
  if(car_mode == 1 || car_mode == 2) //if car is going forwards - stop
  {
    car_mode = 0;
    Serial.println("stop");
  }
  else if(car_mode == 0) //if car is already stopped - go backwards
  {
    car_mode = 2;
    Serial.println("Backwards");
  }

  server.send(200, "text/html", html_index);
}

void handleLeftIndicator()
{
    if(indicator_mode == 0 || indicator_mode == 2) //if left indicator is not right or off - turn on left indicator
    {
      indicator_mode = 1  ;
    }
    else if(indicator_mode == 1) //if left indicator is on - turn off
    {
      indicator_mode = 0;
    }
   server.send(200, "text/html", html_index);
}

void handleRightIndicator() //if indicator is not left or off - turn on right indicator
{
  if(indicator_mode == 0 || indicator_mode == 1)
  {
    indicator_mode = 2;
  }
  else if(indicator_mode == 2) //if right indicator is on - turn off
  {
    indicator_mode = 0;
  }
  server.send(200, "text/html", html_index);
}

void handleEmergency()
{
  if(indicator_mode != 3) //if emergency is off - turn on
  {
    //light_mode = 2;
    indicator_mode = 3;
    Serial.println("Emergency On");
  }
  else if(indicator_mode == 3) //if emergency is on - turn off
  {
    //light_mode = 0;
    indicator_mode = 0;
    Serial.println("Emergency Off");
  }
  server.send(200, "text/html", html_index);
}

void handleLights()
{
  if(light_mode == 0) //if lights are off - turn them on
  {
    light_mode = 1;
    Serial.println("Lights On");
  }
  else if(light_mode == 1) //if lights are on - turn them off
  {
    light_mode = 0;
    Serial.println("Lights Off");
  }
  server.send(200, "text/html", html_index);
}
void handleLeft()
{
  if(steering_mode == 1 ||steering_mode == 2) //if steering is to the right or already left - go straight
  {
    steering_mode = 0;
    Serial.println("Straight");
  }
  else if(steering_mode == 0) //if steering is straight - go left
  {
    steering_mode = 1;
    Serial.println("Left");
  }
  server.send(200, "text/html", html_index);
}

void handleRight()
{
  if(steering_mode == 1 || steering_mode == 2)//if steering is to the left or already right- go straight
   {
    steering_mode = 0;
    Serial.println("Straight");
   }
   else if(steering_mode == 0) //if steering is straight - go right
   {
    steering_mode = 2;
    Serial.println("Right");
   }
   server.send(200, "text/html", html_index);
}

void handleHorn()
{
   
  if(horn_mode == 1)
  {
    horn_mode=0;
  }
  if(horn_mode==0)
  {
    horn_mode=1;
    Serial.println("Honk!");
  }
  server.send(200, "text/html", html_index);
}

void handleOffline()
{
  server.send(200, "text/html",offline_html);
}
void handleManifest()
{
  server.send(200,"application/js",manifest_js);
}

void handleTesla192()
{
  server.send_P(200,"image/png",tesla_192_png,sizeof(tesla_192_png));
}

void handleTesla512()
{
  server.send_P(200,"image/png",tesla_512_png,sizeof(tesla_512_png));
}

void handleServiceWorker()
{
  server.send_P(200,"application/js",serviceWorker_js);
}
void handleRoot() 
{
  server.sendHeader("Location","/index.html");
  server.send(303); 
}

void handleCSS()
{
  server.send_P(200,"text/css",styles_css);
}

void handleIndex()
{
  server.send(200,"text/html",html_index);
}

void handleNotFound() {
  String message = "File Not Found\n\n";
  message += "URI: ";
  message += server.uri();
  message += "\nMethod: ";
  message += (server.method() == HTTP_GET) ? "GET" : "POST";
  message += "\nArguments: ";
  message += server.args();
  message += "\n";
  for (uint8_t i = 0; i < server.args(); i++) {
    message += " " + server.argName(i) + ": " + server.arg(i) + "\n";
  }
  server.send(404, "text/plain", message);
}
